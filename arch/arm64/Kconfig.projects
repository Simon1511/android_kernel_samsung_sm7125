## arch/arm64/Kconfig.projects
```kconfig
config SEC_A52Q_PROJECT
	default n
	bool "Samsung A52Q Project"
	help
	  Support for Samsung A52Q Project

config SEC_A72Q_PROJECT
	default n
	bool "Samsung A72Q Project"
	help
	  Support for Samsung A72Q Project

config SEC_A52Q_EUR_OPEN
	default n
	bool "Samsung A52Q EUR OPEN"
	help
	  Support for Samsung A52Q EUR OPEN device.

config SEC_A72Q_EUR_OPEN
	default n
	bool "Samsung A72Q EUR OPEN"
	help
	  Support for Samsung A72Q EUR OPEN device.
```

## arch/arm64/Kconfig.sec
```kconfig
config SEC_A52Q_PROJECT
        default n
        bool "Samsung A52Q Project"
        help
          Support for Samsung A52Q Project

config SEC_A52Q_EUR_PROJECT
        default n
        bool "Samsung A52Q EUR OPEN Project"
        help
          Support for Samsung A52Q EUR OPEN Project

config SEC_A72Q_PROJECT
        default n
        bool "Samsung A72Q Project"
        help
          Support for Samsung A72Q Project

config SEC_A72Q_EUR_PROJECT
        default n
        bool "Samsung A72Q EUR OPEN Project"
        help
          Support for Samsung A72Q EUR OPEN Project
```
